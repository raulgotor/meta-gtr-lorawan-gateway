## conf/machine/bootlinlabs.conf
```bitbake
require conf/machine/include/st-machine-common-stm32mp.inc
require conf/machine/include/st-machine-providers-stm32mp.inc

# Correct overrides so recipes match stm32mp1 targets
MACHINEOVERRIDES .= ":stm32mp1common:stm32mp15common"
STM32MP_SOC_NAME = "stm32mp15"

DEFAULTTUNE = "cortexa7thf-neon-vfpv4"
require conf/machine/include/arm/armv7a/tune-cortexa7.inc

UBOOT_CONFIG = "default_stm32mp15"
STM32MP_DT_FILES_SDCARD = "stm32mp157f-dk2"

MACHINE_FEATURES = "usbhost usbgadget alsa screen ext2 pci splashscreen watchdog bluetooth wifi m4copro usbg0 optee tpm2 initrd autoresize fip fw-update rtc qemu-usermode"
```
